## CMakeLists.txt
```
cmake_minimum_required(VERSION 3.20.0)

find_package(Zephyr REQUIRED HINTS $ENV{ZEPHYR_BASE})
project(ble_observer)

target_sources(app PRIVATE src/main.c)
```

## prj.conf
```kconfig
CONFIG_BT=y
CONFIG_BT_OBSERVER=y

CONFIG_DISPLAY=y
CONFIG_LOG=y
```

## src/main.c
```c
/*
 * BLE sensor observer for Sheet 4, Task 2.3.
 *
 * SPDX-License-Identifier: Apache-2.0
 */

#include <string.h>

#include <zephyr/bluetooth/bluetooth.h>
#include <zephyr/bluetooth/hci.h>
#include <zephyr/device.h>
#include <zephyr/devicetree.h>
#include <zephyr/drivers/display.h>
#include <zephyr/kernel.h>
#include <zephyr/logging/log.h>
#include <zephyr/sys/byteorder.h>
#include <zephyr/sys/util.h>

#include <app/ble_sensor_format.h>
#include <app/ble_sensor_packet.h>

LOG_MODULE_REGISTER(main, CONFIG_APP_LOG_LEVEL);

#define DISPLAY_MIN_BRIGHTNESS 16U
#define DISPLAY_MAX_BRIGHTNESS 255U

struct received_sample {
	uint8_t sensor_kind;
	int32_t value_1;
	int32_t value_2;
	int32_t value_3;
	int8_t rssi;
};

struct parse_context {
	int8_t rssi;
	bool found;
};

static const struct device *const display = DEVICE_DT_GET(DT_CHOSEN(zephyr_display));
static struct received_sample latest_sample;
static bool have_sample;
static int64_t next_report_ms;
static bool display_available;
static struct k_spinlock sample_lock;
static struct k_work actuator_work;

static int64_t absolute_value(int64_t value)
{
	return value < 0 ? -value : value;
}

static uint8_t scale_brightness(int64_t value, int64_t maximum)
{
	value = CLAMP(value, 0, maximum);

	return DISPLAY_MIN_BRIGHTNESS +
		(uint8_t)(value * (DISPLAY_MAX_BRIGHTNESS - DISPLAY_MIN_BRIGHTNESS) /
			  maximum);
}

static uint8_t sample_brightness(const struct received_sample *sample)
{
	if (sample->sensor_kind == BLE_SENSOR_KIND_ACCELEROMETER) {
		int64_t x = sample->value_1;
		int64_t y = sample->value_2;
		int64_t z = sample->value_3;
		int64_t largest = MAX(MAX(absolute_value(x), absolute_value(y)),
				      absolute_value(z));

		/* Full brightness at roughly 2 g. */
		return scale_brightness(largest, 20000);
	}

	/* For the simulated sensor, map 0-100% relative humidity to brightness. */
	return scale_brightness(sample->value_2, 100000);
}

static void actuator_update(struct k_work *work)
{
	char formatted[BLE_SENSOR_ENVIRONMENTAL_STRING_SIZE];
	struct received_sample sample;
	uint8_t brightness;
	k_spinlock_key_t key;
	int err;

	ARG_UNUSED(work);

	key = k_spin_lock(&sample_lock);
	sample = latest_sample;
	k_spin_unlock(&sample_lock, key);

	brightness = sample_brightness(&sample);

	if (sample.sensor_kind == BLE_SENSOR_KIND_ACCELEROMETER) {
		LOG_INF("Received accel x=%d, y=%d, z=%d mm/s^2, RSSI=%d dBm, LED=%u",
			sample.value_1, sample.value_2, sample.value_3, sample.rssi,
			brightness);
	} else {
		ble_sensor_format_environmental(formatted, sizeof(formatted),
						sample.value_1, sample.value_2);
		LOG_INF("Received %s, RSSI=%d dBm, LED=%u", formatted,
			sample.rssi, brightness);
	}

	if (!display_available) {
		return;
	}

	err = display_set_brightness(display, brightness);
	if (err < 0) {
		LOG_ERR("Could not set LED matrix brightness (%d)", err);
	}
}

static bool manufacturer_data_found(struct bt_data *data, void *user_data)
{
	struct parse_context *context = user_data;
	struct ble_sensor_packet wire_packet;
	struct received_sample sample;
	k_spinlock_key_t key;
	bool report;
	int64_t now;

	if (data->type != BT_DATA_MANUFACTURER_DATA ||
	    data->data_len < sizeof(wire_packet)) {
		return true;
	}

	memcpy(&wire_packet, data->data, sizeof(wire_packet));
	if (sys_le16_to_cpu(wire_packet.company_id) != BLE_SENSOR_COMPANY_ID) {
		return true;
	}

	if (wire_packet.sensor_kind != BLE_SENSOR_KIND_ACCELEROMETER &&
	    wire_packet.sensor_kind != BLE_SENSOR_KIND_TEMP_HUMIDITY) {
		return true;
	}

	sample.sensor_kind = wire_packet.sensor_kind;
	sample.value_1 = (int32_t)sys_le32_to_cpu((uint32_t)wire_packet.value_1);
	sample.value_2 = (int32_t)sys_le32_to_cpu((uint32_t)wire_packet.value_2);
	sample.value_3 = (int32_t)sys_le32_to_cpu((uint32_t)wire_packet.value_3);
	sample.rssi = context->rssi;
	now = k_uptime_get();

	key = k_spin_lock(&sample_lock);
	report = !have_sample || now >= next_report_ms ||
		 sample.sensor_kind != latest_sample.sensor_kind ||
		 sample.value_1 != latest_sample.value_1 ||
		 sample.value_2 != latest_sample.value_2 ||
		 sample.value_3 != latest_sample.value_3;
	latest_sample = sample;
	have_sample = true;
	if (report) {
		next_report_ms = now + 1000;
	}
	k_spin_unlock(&sample_lock, key);

	if (report) {
		k_work_submit(&actuator_work);
	}

	context->found = true;
	return false;
}

static void advertisement_received(const bt_addr_le_t *addr, int8_t rssi,
				   uint8_t adv_type, struct net_buf_simple *ad)
{
	struct parse_context context = {
		.rssi = rssi,
	};

	ARG_UNUSED(addr);
	ARG_UNUSED(adv_type);

	bt_data_parse(ad, manufacturer_data_found, &context);
}

static int display_init(void)
{
	static const uint8_t all_pixels_on[] = {
		0x1f, 0x1f, 0x1f, 0x1f, 0x1f,
	};
	static const struct display_buffer_descriptor descriptor = {
		.buf_size = sizeof(all_pixels_on),
		.width = 5,
		.height = 5,
		.pitch = 8,
	};
	int err;

	if (!device_is_ready(display)) {
		LOG_WRN("LED matrix is not ready; received values will only be logged");
		return -ENODEV;
	}

	err = display_set_pixel_format(display, PIXEL_FORMAT_MONO01);
	if (err < 0) {
		return err;
	}

	err = display_write(display, 0, 0, &descriptor, all_pixels_on);
	if (err < 0) {
		return err;
	}

	err = display_blanking_off(display);
	if (err < 0) {
		return err;
	}

	display_available = true;
	return 0;
}

int main(void)
{
	static const struct bt_le_scan_param scan_parameters = {
		.type = BT_LE_SCAN_TYPE_PASSIVE,
		.options = 0,
		.interval = BT_GAP_SCAN_FAST_INTERVAL_MIN,
		.window = BT_GAP_SCAN_FAST_WINDOW,
	};
	int err;

	BUILD_ASSERT(sizeof(struct ble_sensor_packet) == 15,
		     "Unexpected sensor packet padding");

	k_work_init(&actuator_work, actuator_update);

	err = display_init();
	if (err < 0) {
		LOG_WRN("LED matrix initialization failed (%d)", err);
	}

	err = bt_enable(NULL);
	if (err < 0) {
		LOG_ERR("Bluetooth initialization failed (%d)", err);
		return 0;
	}

	err = bt_le_scan_start(&scan_parameters, advertisement_received);
	if (err < 0) {
		LOG_ERR("Scanning failed to start (%d)", err);
		return 0;
	}

	LOG_INF("Passive scanning started (duplicate filtering disabled)");
	return 0;
}
```

## src/nrf_led_matrix_main.c
```c
/*
 * Copyright (c) 2021, Nordic Semiconductor ASA
 *
 * SPDX-License-Identifier: Apache-2.0
 */

#include <zephyr/kernel.h>
#include <zephyr/sys/printk.h>
#include <zephyr/drivers/display.h>
#include <string.h>

#define PIXEL_BIT(idx, val)  (val ? BIT(idx) : 0)
#define PIXEL_MASK(...)      (FOR_EACH_IDX(PIXEL_BIT, (|), __VA_ARGS__))

static struct display_capabilities caps;
static uint8_t buf[5];
static const struct display_buffer_descriptor buf_desc = {
	.buf_size = sizeof(buf),
	.width    = 5,
	.height   = 5,
	.pitch    = 8,
};

static void update_block_3x3(const struct device *dev)
{
	int ret;
	static const uint8_t small_bufs[][2] = {
		{ PIXEL_MASK(0, 1, 0) |
		  PIXEL_MASK(0, 1, 0) << 4,
		  PIXEL_MASK(0, 1, 0) },
		{ PIXEL_MASK(0, 0, 1) |
		  PIXEL_MASK(0, 1, 0) << 4,
		  PIXEL_MASK(1, 0, 0) },
		{ PIXEL_MASK(0, 0, 0) |
		  PIXEL_MASK(1, 1, 1) << 4,
		  PIXEL_MASK(0, 0, 0) },
		{ PIXEL_MASK(1, 0, 0) |
		  PIXEL_MASK(0, 1, 0) << 4,
		  PIXEL_MASK(0, 0, 1) },
	};
	static const struct display_buffer_descriptor small_buf_desc = {
		.buf_size = sizeof(small_bufs[0]),
		.width    = 3,
		.height   = 3,
		.pitch    = 4,
	};

	for (int i = 0; i < 4 * ARRAY_SIZE(small_bufs); ++i) {
		k_sleep(K_MSEC(100));

		ret = display_write(dev, 1, 1,
				    &small_buf_desc, small_bufs[i % 4]);
		if (ret < 0) {
			printk("display_write failed: %u/%d\n",
				__LINE__, ret);
		}
	}
}

static void update_block_5x5(const struct device *dev)
{
	int ret;

	buf[0] = PIXEL_MASK(0, 0, 0, 0, 1);
	buf[1] = PIXEL_MASK(0, 0, 0, 1, 1);
	buf[2] = PIXEL_MASK(0, 0, 1, 1, 1);
	buf[3] = PIXEL_MASK(0, 1, 1, 1, 1);
	buf[4] = PIXEL_MASK(1, 1, 1, 1, 1);
	ret = display_write(dev, 0, 0, &buf_desc, buf);
	if (ret < 0) {
		printk("display_write failed: %u/%d\n",
			__LINE__, ret);
	}

	for (int i = 0; i < 4 * 5; ++i) {
		uint8_t tmp;

		k_sleep(K_MSEC(100));

		tmp = buf[0];
		buf[0] = buf[1];
		buf[1] = buf[2];
		buf[2] = buf[3];
		buf[3] = buf[4];
		buf[4] = tmp;
		ret = display_write(dev, 0, 0, &buf_desc, buf);
		if (ret < 0) {
			printk("display_write failed: %u/%d\n",
				__LINE__, ret);
		}
	}
}

static void show_all_brightness_levels(const struct device *dev)
{
	int ret;
	uint8_t brightness = 0;

	do {
		--brightness;
		ret = display_set_brightness(dev, brightness);
		if (ret < 0) {
			printk("display_set_brightness failed: %u/%d\n",
				__LINE__, ret);
		}

		k_sleep(K_MSEC(5));
	} while (brightness);
}

static void update_through_framebuffer(const struct device *dev)
{
	uint8_t *framebuf = display_get_framebuffer(dev);
	uint8_t dimmed = 0;
	bool inc = false;
	enum {
		MIN_BRIGHTNESS = 0x0F,
		BLOCK_SIZE     = 5,
		STEPS          = BLOCK_SIZE - 1,
		RUNS           = 4
	};

	if (!framebuf) {
		printk("frame buffer not available\n");
		return;
	}

	/* Clear screen. */
	memset(framebuf, 0, caps.x_resolution * caps.y_resolution);

	for (int i = 0; i < 1 + 3 * RUNS * STEPS; ++i) {
		k_sleep(K_MSEC(100));

		for (uint8_t column = 0; column < BLOCK_SIZE; ++column) {
			for (uint8_t row = 0; row < BLOCK_SIZE; ++row) {
				uint8_t diff;
				uint8_t step = (0xFF - MIN_BRIGHTNESS) / STEPS;

				/*
				 * Depending on the iteration, use different
				 * pixel values for:
				 * - vertical lines
				 */
				if (i < 1 * RUNS * STEPS) {
					diff = dimmed > column
					     ? dimmed - column
					     : column - dimmed;
				/*
				 * - horizontal lines
				 */
				} else if (i < 2 * RUNS * STEPS) {
					diff = dimmed > row
					     ? dimmed - row
					     : row - dimmed;
				/*
				 * - diagonal lines
				 */
				} else {
					uint8_t dist = column + row;

					diff = 2 * dimmed > dist
					     ? 2 * dimmed - dist
					     : dist - 2 * dimmed;
					step /= 2;
				}

				framebuf[column + row * caps.x_resolution] =
					MIN_BRIGHTNESS + diff * step;
			}
		}

		if (dimmed == 0 || dimmed == STEPS) {
			inc = !inc;
		}
		if (inc) {
			++dimmed;
		} else {
			--dimmed;
		}
	}
}

int main(void)
{
	printk("nRF LED matrix sample on %s\n", CONFIG_BOARD);

	int ret;
	const struct device *const dev = DEVICE_DT_GET_ONE(nordic_nrf_led_matrix);

	if (!dev) {
		printk("Display device not ready\n");
		return 0;
	}

	display_get_capabilities(dev, &caps);
	if (!(caps.supported_pixel_formats & PIXEL_FORMAT_MONO01)) {
		printk("Expected pixel format not supported\n");
		return 0;
	}

	ret = display_set_pixel_format(dev, PIXEL_FORMAT_MONO01);
	if (ret < 0) {
		printk("display_set_pixel_format failed: %u/%d\n",
			__LINE__, ret);
	}

	printk("Started\n");

	for (;;) {
		ret = display_set_brightness(dev, 0x7F);
		if (ret < 0) {
			printk("display_set_brightness failed: %u/%d\n",
				__LINE__, ret);
		}

		buf[0] = PIXEL_MASK(1, 0, 1, 0, 1);
		buf[1] = PIXEL_MASK(1, 1, 0, 0, 1);
		buf[2] = PIXEL_MASK(1, 0, 1, 0, 1);
		buf[3] = PIXEL_MASK(1, 0, 0, 1, 1);
		buf[4] = PIXEL_MASK(1, 0, 1, 0, 1);
		ret = display_write(dev, 0, 0, &buf_desc, buf);
		if (ret < 0) {
			printk("display_write failed: %u/%d\n",
				__LINE__, ret);
		}

		ret = display_blanking_off(dev);
		if (ret < 0) {
			printk("display_blanking_off failed: %u/%d\n",
				__LINE__, ret);
		}

		k_sleep(K_MSEC(500));

		update_block_3x3(dev);

		k_sleep(K_MSEC(500));

		update_block_5x5(dev);

		k_sleep(K_MSEC(200));

		ret = display_blanking_on(dev);
		if (ret < 0) {
			printk("display_blanking_on failed: %u/%d\n",
				__LINE__, ret);
		}

		k_sleep(K_MSEC(500));

		ret = display_blanking_off(dev);
		if (ret < 0) {
			printk("display_blanking_off failed: %u/%d\n",
				__LINE__, ret);
		}

		k_sleep(K_MSEC(500));

		show_all_brightness_levels(dev);

		update_through_framebuffer(dev);

		k_sleep(K_MSEC(500));
	}
	return 0;
}
```
