## debugging_exercise/build/Kconfig/Kconfig.shield.defconfig
```kconfig
osource "/Users/nm/zephyrproject/example-application/boards/shields/*/Kconfig.defconfig"
```

## debugging_exercise/build/Kconfig/arch/Kconfig
```kconfig
# Load Zephyr Arch Kconfig descriptions.
osource "/Users/nm/zephyrproject/zephyr/arch/rx/Kconfig"
osource "/Users/nm/zephyrproject/zephyr/arch/x86/Kconfig"
osource "/Users/nm/zephyrproject/zephyr/arch/xtensa/Kconfig"
osource "/Users/nm/zephyrproject/zephyr/arch/sparc/Kconfig"
osource "/Users/nm/zephyrproject/zephyr/arch/riscv/Kconfig"
osource "/Users/nm/zephyrproject/zephyr/arch/posix/Kconfig"
osource "/Users/nm/zephyrproject/zephyr/arch/openrisc/Kconfig"
osource "/Users/nm/zephyrproject/zephyr/arch/mips/Kconfig"
osource "/Users/nm/zephyrproject/zephyr/arch/arm64/Kconfig"
osource "/Users/nm/zephyrproject/zephyr/arch/arm/Kconfig"
osource "/Users/nm/zephyrproject/zephyr/arch/arc/Kconfig"
```

## debugging_exercise/build/Kconfig/boards/Kconfig.defconfig
```kconfig
# Load Zephyr board defconfig descriptions.
osource "/Users/nm/zephyrproject/zephyr/boards/bbc/microbit_v2/Kconfig.defconfig"
```

## drivers/blink/Kconfig
```kconfig
# Copyright (c) 2024 Nordic Semiconductor ASA
# SPDX-License-Identifier: Apache-2.0

menuconfig BLINK
	bool "Blink device drivers"
	help
	  This option enables the blink custom driver class.

if BLINK

config BLINK_INIT_PRIORITY
	int "Blink device drivers init priority"
	default 90
	help
	  Blink device drivers init priority. Must be greater than
	  CONFIG_DISPLAY_INIT_PRIORITY (default 85) to ensure display
	  devices are initialized before blink drivers that depend on them.

module = BLINK
module-str = blink
source "subsys/logging/Kconfig.template.log_config"

rsource "Kconfig.gpio_led"
rsource "Kconfig.matrix_led"

endif # BLINK
```

## drivers/blink/Kconfig.matrix_led
```kconfig
# Copyright (c) 2024 Nordic Semiconductor ASA
# SPDX-License-Identifier: Apache-2.0

config BLINK_MATRIX_LED
	bool "LED matrix-controlled blink driver"
	default y
	depends on DT_HAS_BLINK_MATRIX_LED_ENABLED
	select DISPLAY
	help
	  Enable this option to use the LED matrix-controlled blink driver. This
	  driver wraps the Nordic LED matrix display driver to provide a simple
	  blink interface compatible with the blink driver class.
```

## dts/bindings/blink/blink-matrix-led.yaml
```yaml
# Copyright (c) 2024 Nordic Semiconductor ASA
# SPDX-License-Identifier: Apache-2.0

description: |
  A binding for an LED matrix-controlled blinking LED driver. This driver
  wraps the Nordic LED matrix display driver to provide a simple blink interface.

  Example definition in devicetree:

    blink-matrix-led {
        compatible = "blink-matrix-led";
        display = <&led_matrix>;
        blink-period-ms = <1000>;
        brightness-level = <128>;
    };

compatible: "blink-matrix-led"

include: base.yaml

properties:
  display:
    type: phandle
    required: true
    description: Reference to the LED matrix display device.

  blink-period-ms:
    type: int
    description: Initial blinking period in milliseconds.

  brightness-level:
    type: int
    description: Matrix brightness, in steps of 1/256. 255 is full brightness and 0 is minimal, matching display_set_brightness().
```

## tracing_exercise/build/Kconfig/Kconfig.modules
```kconfig
menu "example-application (/Users/nm/zephyrproject/example-application)"
osource "/Users/nm/zephyrproject/example-application/Kconfig"
config ZEPHYR_EXAMPLE_APPLICATION_MODULE
	bool
	default y
endmenu
menu "cmsis_6 (/Users/nm/zephyrproject/modules/hal/cmsis_6)"
osource "$(ZEPHYR_CMSIS_6_KCONFIG)"
config ZEPHYR_CMSIS_6_MODULE
	bool
	default y
endmenu
menu "hal_nordic (/Users/nm/zephyrproject/modules/hal/nordic)"
osource "$(ZEPHYR_HAL_NORDIC_KCONFIG)"
config ZEPHYR_HAL_NORDIC_MODULE
	bool
	default y

config ZEPHYR_HAL_NORDIC_MODULE_BLOBS
	bool
endmenu
config ZEPHYR_HAL_STM32_MODULE
	bool
	default y

config ZEPHYR_HAL_STM32_MODULE_BLOBS
	bool
menu "segger (/Users/nm/zephyrproject/modules/debug/segger)"
osource "$(ZEPHYR_SEGGER_KCONFIG)"
config ZEPHYR_SEGGER_MODULE
	bool
	default y
endmenu
```

## tracing_exercise/build/Kconfig/Kconfig.shield
```kconfig
osource "/Users/nm/zephyrproject/example-application/boards/shields/*/Kconfig.shield"
```

## tracing_exercise/build/Kconfig/boards/Kconfig.bbc_microbit_v2.tmp
```kconfig
# Load board Kconfig descriptions.
osource "/Users/nm/zephyrproject/zephyr/boards/bbc/microbit_v2/Kconfig.bbc_microbit_v2"
```

## tracing_exercise/build/Kconfig/boards/Kconfig.sysbuild.tmp
```kconfig
# Load Sysbuild board Kconfig descriptions.
osource "/Users/nm/zephyrproject/zephyr/boards/bbc/microbit_v2/Kconfig.sysbuild"
```
